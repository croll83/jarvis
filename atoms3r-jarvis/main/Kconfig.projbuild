## atoms3r-jarvis/main/Kconfig.projbuild
```kconfig
menu "JARVIS Configuration"

    config WIFI_SSID
        string "WiFi SSID"
        default "YOUR_WIFI_SSID"
        help
            SSID della rete WiFi

    config WIFI_PASSWORD
        string "WiFi Password"
        default "YOUR_WIFI_PASSWORD"
        help
            Password della rete WiFi

    config JARVIS_SERVER_HOST
        string "JARVIS Management Server Host"
        default "jarvis.local"
        help
            Hostname o IP del wakeword-server (LAN).
            Le chiamate HTTP di management (device_config, heartbeat,
            device_status, room_temperature, speaker/suppress) vengono
            inviate qui. Il wakeword-server le inoltra all'orchestrator
            via Tailscale.

    config JARVIS_SERVER_PORT
        int "JARVIS Management Server Port"
        default 8200
        help
            Porta del wakeword-server per le chiamate HTTP di management.
            Default: 8200 (porta standard del wakeword-server).

    config JARVIS_API_TOKEN
        string "JARVIS API Bearer Token"
        default ""
        help
            Token statico per autenticazione Bearer.
            Deve corrispondere al token configurato nell'orchestrator.
            Se vuoto, nessun header Authorization viene inviato.

    config JARVIS_WS_URL
        string "JARVIS WebSocket URL override"
        default ""
        help
            Full WebSocket URL override for the audio endpoint.
            When set, the device connects to this URL instead of building
            it from SERVER_HOST:PORT/ws/audio.
            Use for wakeword-server proxy: "ws://192.168.1.XX:8200/ws/audio"
            Leave empty to use the default (SERVER_HOST:PORT).

    config USE_LOCAL_WAKEWORD
        bool "Use local microWakeWord (on-device)"
        default n
        help
            Enable on-device wake word detection using microWakeWord (TFLite).
            When disabled (default), the device streams audio 24/7 to a
            wakeword-server which handles wake word detection server-side.
            Enable this for standalone operation without a wakeword-server.

    # NOTA: DEVICE_ROOM e DEVICE_ID sono stati rimossi.
    # Il device_id è ora il MAC address (letto a runtime).
    # La configurazione viene recuperata dinamicamente dal server.

endmenu
```

## atoms3r-jarvis/sdkconfig.defaults
```kconfig
# =============================================================================
# JARVIS AtomS3R - ESP-IDF SDK Configuration Defaults
# =============================================================================
#
# Hardware: M5Stack AtomS3R (ESP32-S3-PICO-1-N8R8)
# - Flash: 8MB (Octal SPI)
# - PSRAM: 8MB (Octal SPI)
#
# =============================================================================

# Target: ESP32-S3
CONFIG_IDF_TARGET="esp32s3"

# =============================================================================
# Flash Configuration (8MB OPI)
# =============================================================================
CONFIG_ESPTOOLPY_FLASHSIZE_8MB=y
CONFIG_ESPTOOLPY_FLASHMODE_OPI=y
CONFIG_ESPTOOLPY_FLASH_SAMPLE_MODE_STR=y
CONFIG_ESPTOOLPY_FLASHFREQ_80M=y

# =============================================================================
# PSRAM Configuration (8MB OPI)
# =============================================================================
CONFIG_SPIRAM=y
CONFIG_SPIRAM_MODE_OCT=y
CONFIG_SPIRAM_TYPE_AUTO=y
CONFIG_SPIRAM_SPEED_80M=y
CONFIG_SPIRAM_BOOT_INIT=y
CONFIG_SPIRAM_USE_MALLOC=y
CONFIG_SPIRAM_MALLOC_ALWAYSINTERNAL=4096
CONFIG_SPIRAM_MALLOC_RESERVE_INTERNAL=32768
CONFIG_SPIRAM_ALLOW_STACK_EXTERNAL_MEMORY=y

# PSRAM timing tuning per OPI
CONFIG_SPIRAM_FETCH_INSTRUCTIONS=y
CONFIG_SPIRAM_RODATA=y

# =============================================================================
# Partition Table
# =============================================================================
CONFIG_PARTITION_TABLE_CUSTOM=y
CONFIG_PARTITION_TABLE_CUSTOM_FILENAME="partitions.csv"

# =============================================================================
# microWakeWord (TFLite Micro) — no ESP-SR needed
# =============================================================================
# Wake word detection uses a custom TFLite model (jarvis_it.tflite)
# loaded at compile time. ESP-NN acceleration enabled for fast inference.

# =============================================================================
# CPU and FreeRTOS
# =============================================================================
CONFIG_ESP32S3_DEFAULT_CPU_FREQ_240=y
CONFIG_FREERTOS_HZ=1000

# Stack sizes
CONFIG_ESP_MAIN_TASK_STACK_SIZE=16384
CONFIG_PTHREAD_TASK_STACK_SIZE_DEFAULT=4096

# Task Watchdog (più tollerante durante init pesante)
CONFIG_ESP_TASK_WDT_TIMEOUT_S=10

# =============================================================================
# WiFi
# =============================================================================
CONFIG_ESP_WIFI_STATIC_RX_BUFFER_NUM=10
CONFIG_ESP_WIFI_DYNAMIC_RX_BUFFER_NUM=32
CONFIG_ESP_WIFI_DYNAMIC_TX_BUFFER_NUM=32

# =============================================================================
# TLS / HTTPS (per connessione a jarvis.mintwork.it:443)
# =============================================================================
CONFIG_ESP_TLS_USING_MBEDTLS=y
CONFIG_MBEDTLS_CERTIFICATE_BUNDLE=y
CONFIG_MBEDTLS_CERTIFICATE_BUNDLE_DEFAULT_FULL=y

# =============================================================================
# I2S/I2C Legacy API (suppress deprecation warnings)
# =============================================================================
CONFIG_I2S_SUPPRESS_DEPRECATE_WARN=y
CONFIG_I2C_SUPPRESS_DEPRECATE_WARN=y

# =============================================================================
# Log Level
# =============================================================================
CONFIG_LOG_DEFAULT_LEVEL_INFO=y
CONFIG_LOG_MAXIMUM_LEVEL_DEBUG=y

# =============================================================================
# Bootloader
# =============================================================================
CONFIG_BOOTLOADER_LOG_LEVEL_INFO=y
CONFIG_BOOTLOADER_SKIP_VALIDATE_ON_POWER_ON=y

# =============================================================================
# Compiler Optimization (per risparmiare flash)
# =============================================================================
CONFIG_COMPILER_OPTIMIZATION_PERF=y

# =============================================================================
# Device Configuration (da personalizzare via menuconfig)
# =============================================================================
CONFIG_WIFI_SSID="YOUR_WIFI_SSID"
CONFIG_WIFI_PASSWORD="YOUR_WIFI_PASSWORD"
CONFIG_JARVIS_SERVER_HOST="jarvis.local"
CONFIG_JARVIS_SERVER_PORT=8200
CONFIG_JARVIS_API_TOKEN=""
# NOTA: JARVIS_SERVER_HOST:PORT punta al wakeword-server (LAN), che fa proxy
# delle chiamate HTTP management (device_config, heartbeat, device_status,
# room_temperature, speaker/suppress) all'orchestrator via Tailscale.
# Il device_id è il MAC address (letto a runtime).
# La configurazione viene recuperata dal server via /device_config.
```
