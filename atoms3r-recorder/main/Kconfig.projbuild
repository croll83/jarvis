## atoms3r-recorder/main/Kconfig.projbuild
```kconfig
menu "Recorder Configuration"

    config WIFI_SSID
        string "WiFi SSID"
        default "YOUR_WIFI_SSID"

    config WIFI_PASSWORD
        string "WiFi Password"
        default "YOUR_WIFI_PASSWORD"

    config RECORDER_SERVER_HOST
        string "Recording Server IP"
        default "192.168.1.100"
        help
            IP del Mac su cui gira record_from_atom.py

    config RECORDER_SERVER_PORT
        int "Recording Server Port"
        default 5555

endmenu
```

## atoms3r-recorder/sdkconfig.defaults
```kconfig
# =============================================================================
# AtomS3R Recorder - ESP-IDF SDK Configuration Defaults
# =============================================================================
# Firmware minimale per registrazione audio via TCP.
# Hardware: M5Stack AtomS3R (ESP32-S3-PICO-1-N8R8)
# =============================================================================

CONFIG_IDF_TARGET="esp32s3"

# Flash (8MB OPI)
CONFIG_ESPTOOLPY_FLASHSIZE_8MB=y
CONFIG_ESPTOOLPY_FLASHMODE_OPI=y
CONFIG_ESPTOOLPY_FLASH_SAMPLE_MODE_STR=y
CONFIG_ESPTOOLPY_FLASHFREQ_80M=y

# PSRAM (8MB OPI)
CONFIG_SPIRAM=y
CONFIG_SPIRAM_MODE_OCT=y
CONFIG_SPIRAM_TYPE_AUTO=y
CONFIG_SPIRAM_SPEED_80M=y
CONFIG_SPIRAM_BOOT_INIT=y
CONFIG_SPIRAM_USE_MALLOC=y
CONFIG_SPIRAM_MALLOC_ALWAYSINTERNAL=4096
CONFIG_SPIRAM_MALLOC_RESERVE_INTERNAL=32768
CONFIG_SPIRAM_ALLOW_STACK_EXTERNAL_MEMORY=y
CONFIG_SPIRAM_FETCH_INSTRUCTIONS=y
CONFIG_SPIRAM_RODATA=y

# Partition table
CONFIG_PARTITION_TABLE_CUSTOM=y
CONFIG_PARTITION_TABLE_CUSTOM_FILENAME="partitions.csv"

# CPU / FreeRTOS
CONFIG_ESP32S3_DEFAULT_CPU_FREQ_240=y
CONFIG_FREERTOS_HZ=1000
CONFIG_ESP_MAIN_TASK_STACK_SIZE=8192
CONFIG_ESP_TASK_WDT_TIMEOUT_S=10

# WiFi
CONFIG_ESP_WIFI_STATIC_RX_BUFFER_NUM=10
CONFIG_ESP_WIFI_DYNAMIC_RX_BUFFER_NUM=32
CONFIG_ESP_WIFI_DYNAMIC_TX_BUFFER_NUM=32

# I2S/I2C Legacy API
CONFIG_I2S_SUPPRESS_DEPRECATE_WARN=y
CONFIG_I2C_SUPPRESS_DEPRECATE_WARN=y

# Log
CONFIG_LOG_DEFAULT_LEVEL_INFO=y
CONFIG_LOG_MAXIMUM_LEVEL_DEBUG=y

# Bootloader
CONFIG_BOOTLOADER_LOG_LEVEL_INFO=y
CONFIG_BOOTLOADER_SKIP_VALIDATE_ON_POWER_ON=y

# Compiler
CONFIG_COMPILER_OPTIMIZATION_PERF=y

# Device Configuration (override in sdkconfig.local)
CONFIG_WIFI_SSID="YOUR_WIFI_SSID"
CONFIG_WIFI_PASSWORD="YOUR_WIFI_PASSWORD"
CONFIG_RECORDER_SERVER_HOST="192.168.1.100"
CONFIG_RECORDER_SERVER_PORT=5555
```
